## boards/arm/accelerando_barangaroo/Kconfig.board
```kconfig
# Accelerando Barangaroo (with eByte E73-2G4M04S1B nRF52832 system on module) configuration

config BOARD_ACCELERANDO_BARANGAROO
	bool "Accelerando Barangaroo"
	depends on SOC_NRF52832_QFAA
```

## boards/arm/accelerando_barangaroo/Kconfig.defconfig
```kconfig
# Accelerando Barangaroo (with eByte E73-2G4M04S1B nRF52832 system on module) configuration

if BOARD_ACCELERANDO_BARANGAROO

config BOARD
	default "accelerando_barangaroo"

config BT_CTLR
	default BT

endif 
```

## boards/arm/ebyte_e73_2g4m04s1b/Kconfig.defconfig
```kconfig
# eByte E73-2G4M04S1B nRF52832 system on module configuration

if BOARD_EBYTE_E73_2G4M04S1B

config BOARD
	default "ebyte_e73_2g4m04s1b"

config BT_CTLR
	default BT

endif 
```

## boards/arm/ebyte_e73_2g4m08s1c_nrf52840/Kconfig
```kconfig
# Adafruit Feather nRF52840 Express board configuration

# Copyright (c) 2020 Tobias Svehagen
# SPDX-License-Identifier: Apache-2.0

config BOARD_ENABLE_DCDC
	bool "Enable DCDC mode"
	select SOC_DCDC_NRF52X
	default y
	depends on BOARD_EBYTE_E73_2G4M08S1C_NRF52840
```

## boards/arm/ebyte_e73_2g4m08s1c_nrf52840/Kconfig.board
```kconfig
# eByte E73-2G4M08S1C nrf52840 System-on-module configuration

# Copyright (c) 2020 Tobias Svehagen
# SPDX-License-Identifier: Apache-2.0

config BOARD_EBYTE_E73_2G4M08S1C_NRF52840
	bool "eByte E73-2G4M08S1C nrf52840 System-on-module"
	depends on SOC_NRF52840_QIAA
```

## boards/arm/ebyte_e73_2g4m08s1c_nrf52840/Kconfig.defconfig
```kconfig
# eByte E73-2G4M08S1C nrf52840 System-on-module configuration

# Copyright (c) 2020 Tobias Svehagen
# SPDX-License-Identifier: Apache-2.0

if BOARD_EBYTE_E73_2G4M08S1C_NRF52840

config BOARD
	default "ebyte_e73_2g4m08s1c_nrf52840"

if USB

config USB_NRFX
	default y

config USB_DEVICE_STACK
	default y

endif # USB

config IEEE802154_NRF5
	default y
	depends on IEEE802154

config I2C
	default y

config BT_CTLR
	default BT

endif # BOARD_EBYTE_E73_2G4M08S1C_NRF52840
```

## boards/arm/nrf51_cjmcu8223/Kconfig.board
```kconfig
# nRF51 CJMCU-8223 board configuration

config BOARD_NRF51_CJMCU8223
	bool "nRF51 CJMCU-8223"
	depends on SOC_NRF51822_QFAA
```

## boards/arm/nrf51_cjmcu8223/Kconfig.defconfig
```kconfig
# nRF51 CJMCU8223 board configuration

if BOARD_NRF51_CJMCU8223

config BOARD
	default "nrf51_cjmcu8223"

config BT_CTLR
	default BT

endif # BOARD_NRF51_CJMCU8223
```

## boards/arm/nrf51_ibutton/Kconfig.board
```kconfig
# nRF51 iButton board configuration

config BOARD_NRF51_IBUTTON
	bool "nRF51 iButton"
	depends on SOC_NRF51822_QFAA
```

## boards/arm/nrf51_ibutton/Kconfig.defconfig
```kconfig
# nRF51 iButton board configuration

if BOARD_NRF51_IBUTTON

config BOARD
	default "nrf51_ibutton"

config BT_CTLR
	default BT

endif
```

## boards/arm/nrf51_ibutton/nrf51_ibutton_defconfig
```kconfig
# SPDX-License-Identifier: Apache-2.0

CONFIG_SOC_SERIES_NRF51X=y
CONFIG_SOC_NRF51822_QFAA=y
CONFIG_BOARD_NRF51_IBUTTON=y

# enable GPIO
CONFIG_GPIO=y

# This generic button device does not break out uart pins :(
# enable uart driver
# CONFIG_SERIAL=y

# enable console
# CONFIG_CONSOLE=y
# CONFIG_UART_CONSOLE=y
```

## boards/arm/nrf51_sensortag/Kconfig.board
```kconfig
# nRF51 Sensor Tag board configuration

config BOARD_NRF51_SENSORTAG
	bool "nRF51 Sensor Tag"
	depends on SOC_NRF51822_QFAA
```

## boards/arm/nrf51_sensortag/Kconfig.defconfig
```kconfig
# nRF51 Sensor Tag board configuration

if BOARD_NRF51_SENSORTAG

config BOARD
	default "nrf51_sensortag"

config BT_CTLR
	default BT

endif # BOARD_NRF51_SENSORTAG
```

## boards/arm/nrf52840_sparkfun/Kconfig.board
```kconfig
# Sparkfun nrf52840 mini breakout

config BOARD_NRF52840_SPARKFUN
	bool "Sparkfun nrf52840 mini breakout"
	depends on SOC_NRF52840_QIAA
```

## boards/arm/nrf52840_sparkfun/Kconfig.defconfig
```kconfig
# Sparkfun nrf52840 mini breakout

if BOARD_NRF52840_SPARKFUN

config BOARD
	default "nrf52840_sparkfun"

if USB

config USB_NRFX
	default y

config USB_DEVICE_STACK
	default y

endif # USB

config IEEE802154_NRF5
	default y
	depends on IEEE802154

config BT_CTLR
	default BT

endif # BOARD_NRF52840_SPARKFUN
```

## drivers/sensor/lis2dh/Kconfig
```kconfig
# LIS2DH Three Axis Accelerometer configuration options

# Copyright (c) 2017 Intel Corporation
# SPDX-License-Identifier: Apache-2.0

menuconfig LIS2DH
	bool "LIS2DH Three Axis Accelerometer"
	depends on I2C || SPI
	help
	  Enable SPI/I2C-based driver for LIS2DH, LIS3DH, LSM303DLHC,
	  LIS2DH12, LSM303AGR triaxial accelerometer sensors.

if LIS2DH

choice LIS2DH_TRIGGER_MODE
	prompt "Trigger mode"
	help
	  Specify the type of triggering to be used by the driver.

config LIS2DH_TRIGGER_NONE
	bool "No trigger"

config LIS2DH_TRIGGER_GLOBAL_THREAD
	bool "Use global thread"
	depends on GPIO
	select LIS2DH_TRIGGER

config LIS2DH_TRIGGER_OWN_THREAD
	bool "Use own thread"
	depends on GPIO
	select LIS2DH_TRIGGER

endchoice

config LIS2DH_TRIGGER
	bool

config LIS2DH_TRIGGER_ANYM_INT1
	bool "Use INT1 for any-motion trigger instead of INT2"
	depends on LIS2DH_TRIGGER

config LIS2DH_THREAD_PRIORITY
	int "Thread priority"
	depends on LIS2DH_TRIGGER_OWN_THREAD
	default 10
	help
	  Priority of thread used by the driver to handle interrupts.

config LIS2DH_INTERRUPT_ACTIVE_LOW
	bool "Set interrupt pins to active low"
	depends on LIS2DH_TRIGGER
	default false
	help
	  Default mode of interrupt pins is active high.
	  Enable this option to invert the pins to active low.

config LIS2DH_THREAD_STACK_SIZE
	int "Thread stack size"
	depends on LIS2DH_TRIGGER_OWN_THREAD
	default 1024
	help
	  Stack size of thread used by the driver to handle interrupts.

choice
	prompt "Acceleration measurement range"
	default LIS2DH_ACCEL_RANGE_RUNTIME
	help
	  Initial measurement full scale range for acceleration values.

config LIS2DH_ACCEL_RANGE_RUNTIME
	bool "Set at runtime"

config LIS2DH_ACCEL_RANGE_2G
	bool "+/-2g"

config LIS2DH_ACCEL_RANGE_4G
	bool "+/-4g"

config LIS2DH_ACCEL_RANGE_8G
	bool "+/-8g"

config LIS2DH_ACCEL_RANGE_16G
	bool "+/-16g"

endchoice

config LIS2DH_ACT_RUNTIME
	bool "Enable setting of activity-based mode switch at runtime"
	default false

choice
	prompt "High-pass Filter mode"
	default LIS2DH_HP_MODE_NORMAL
	help
	  Use of high-pass filter to subtract DC component of acceleration.

config LIS2DH_HP_MODE_NORMAL
	bool "NORMAL - read REFERENCE register to reset DC correction"

config LIS2DH_HP_MODE_REFERENCE
	bool "REFERENCE - subtract content of REFERENCE register from readings"

config LIS2DH_HP_MODE_AUTORESET
	bool "AUTORESET - reset REFERENCE whenever an interrupt occurs"
endchoice

choice
	prompt "High-pass Filter cutoff frequency"
	default LIS2DH_HP_CUTOFF_50X
	help
	  Relative cutoff frequency of the high-pass filter

config LIS2DH_HP_CUTOFF_50X
	bool "High-Pass Filter cutoff freqency is ODR*50"

config LIS2DH_HP_CUTOFF_100X
	bool "High-Pass Filter cutoff freqency is ODR*100"

config LIS2DH_HP_CUTOFF_200X
	bool "High-Pass Filter cutoff freqency is ODR*200"

config LIS2DH_HP_CUTOFF_400X
	bool "High-Pass Filter cutoff freqency is ODR*400"
endchoice


config LIS2DH_HP_OUTPUT
	bool "Apply high-pass filter to the acceleration output values"

config LIS2DH_HP_INT1
	bool "Apply high-pass filter to the interrupt 1 algorithm"

config LIS2DH_HP_INT2
	bool "Apply high-pass filter to the interrupt 2 algorithm"

choice
	prompt "Operation mode"
	default LIS2DH_OPER_MODE_NORMAL
	help
	  Choose between high resolution, normal or low power operation
	  mode for chip at init.

config LIS2DH_OPER_MODE_HIGH_RES
	bool "high resolution (12 bit)"

config LIS2DH_OPER_MODE_NORMAL
	bool "normal (10 bit)"

config LIS2DH_OPER_MODE_LOW_POWER
	bool "low power (8 bit)"

endchoice

choice
	prompt "Output data rate frequency"
	default LIS2DH_ODR_RUNTIME
	help
	  Initial data rate frequency of acceleration data at initialization.
	  Supported values:
	  1Hz, 10Hz, 25Hz, 50Hz, 100Hz, 200Hz, 400Hz in all power modes
	  1620Hz, 5376Hz in low power mode only
	  1344Hz in normal power mode

config LIS2DH_ODR_RUNTIME
	bool "Set at runtime"

config LIS2DH_ODR_1
	bool "1Hz"

config LIS2DH_ODR_2
	bool "10Hz"

config LIS2DH_ODR_3
	bool "25Hz"

config LIS2DH_ODR_4
	bool "50Hz"

config LIS2DH_ODR_5
	bool "100Hz"

config LIS2DH_ODR_6
	bool "200Hz"

config LIS2DH_ODR_7
	bool "400Hz"

config LIS2DH_ODR_8
	bool "1.6KHz"
	depends on LIS2DH_OPER_MODE_LOW_POWER

config LIS2DH_ODR_9_NORMAL
	bool "1.25KHz"
	depends on LIS2DH_OPER_MODE_NORMAL || LIS2DH_OPER_MODE_HIGH_RES

config LIS2DH_ODR_9_LOW
	bool "5KHz"
	depends on LIS2DH_OPER_MODE_LOW_POWER

endchoice

endif # LIS2DH
```

## drivers/sensor/si7210/Kconfig
```kconfig
# SI7210 hall-effect and temperature sensor configuration options

# Copyright (c) 2020 Accelerando
# SPDX-License-Identifier: Apache-2.0

config SI7210
	bool "SI7210 Hall-Effect and Temperature Sensor"
	depends on I2C
	help
	  Enable driver for SI7210 Hall-effect sensors.
```

## dts/bindings/sensor/silabs,si7210.yaml
```yaml
# Copyright (c) 2019, Actinius
# SPDX-License-Identifier: Apache-2.0

description: Si7210 Hall-effect sensor with temperature

compatible: "silabs,si7210"

include: i2c-device.yaml
```

## samples/bluetooth/scanner/sample.yaml
```yaml
sample:
  name: Bluetooth Scanner
tests:
  sample.bluetooth.scanner:
    harness: bluetooth
    platform_whitelist: qemu_cortex_m3 qemu_x86
    tags: bluetooth
```
