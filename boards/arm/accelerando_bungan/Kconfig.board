## boards/arm/accelerando_bungan/accelerando_bungan_defconfig
```kconfig
# SPDX-License-Identifier: Apache-2.0

CONFIG_SOC_SERIES_NRF52X=y
CONFIG_SOC_NRF52832_QFAA=y
CONFIG_BOARD_ACCELERANDO_BUNGAN=y

# Enable MPU
CONFIG_ARM_MPU=y

# enable GPIO
CONFIG_GPIO=y

# enable uart driver
CONFIG_SERIAL=y

# enable console
CONFIG_CONSOLE=y
CONFIG_UART_CONSOLE=y

#CONFIG_USE_SEGGER_RTT=y
#CONFIG_RTT_CONSOLE=y

# Enable P0_21 as RST
#CONFIG_GPIO_AS_PINRESET=y

# 32kHz clock source
CONFIG_SENSOR=y
CONFIG_MULTITHREADING=y
CONFIG_TEMP_NRF5=y
CONFIG_CLOCK_CONTROL_NRF_K32SRC_RC=y
CONFIG_CLOCK_CONTROL_NRF_K32SRC_500PPM=y
```

## boards/arm/accelerando_hailstone/Kconfig
```kconfig
# Accelerando Hailstone board configuration

if BOARD_ACCELERANDO_HAILSTONE

config BOARD_ENABLE_DCDC
	bool "Enable DCDC mode"
	select SOC_DCDC_NRF52X
	default y
	depends on BOARD_ACCELERANDO_HAILSTONE

config BOARD_ENABLE_DCDC_HV
	bool "High Voltage DCDC converter"
	select SOC_DCDC_NRF52X_HV
	default y

endif # BOARD_ACCELERANDO_HAILSTONE
```

## boards/arm/accelerando_hailstone/accelerando_hailstone_defconfig
```kconfig
# SPDX-License-Identifier: Apache-2.0

CONFIG_SOC_SERIES_NRF52X=y
CONFIG_SOC_NRF52840_QIAA=y
CONFIG_BOARD_ACCELERANDO_HAILSTONE=y

# 32kHz clock source
CONFIG_CLOCK_CONTROL_NRF_K32SRC_RC=y
CONFIG_CLOCK_CONTROL_NRF_K32SRC_500PPM=y

# Enable MPU
CONFIG_ARM_MPU=y

# Enable hardware stack protection
#CONFIG_HW_STACK_PROTECTION=y

# enable GPIO
CONFIG_GPIO=y

# enable uart driver
CONFIG_SERIAL=y

# enable console
CONFIG_CONSOLE=y

# USB id
#CONFIG_USB_DEVICE_VID=0x1209
#CONFIG_USB_DEVICE_PID=0xACC1
# Logger cannot use itself to log
#CONFIG_USB_CDC_ACM_LOG_LEVEL_OFF=y

# enable USB
#CONFIG_USB_DEVICE_STACK=y
```

## boards/arm/accelerando_korumba/Kconfig.board
```kconfig
# Accelerando Korumba with STM32G030F6 

# SPDX-License-Identifier: Apache-2.0

config BOARD_ACCELERANDO_KORUMBA
	bool "Accelerando Korumba"
	depends on SOC_STM32G030XX
```

## boards/arm/accelerando_korumba/Kconfig.defconfig
```kconfig
# Accelerando Korumba configuration

# SPDX-License-Identifier: Apache-2.0

if BOARD_ACCELERANDO_KORUMBA

config BOARD
	default "accelerando_korumba"

endif # BOARD_ACCELERANDO_KORUMBA
```

## boards/arm/ebyte_e104_bt5032a/ebyte_e104_bt5032a_defconfig
```kconfig
# SPDX-License-Identifier: Apache-2.0

CONFIG_SOC_SERIES_NRF52X=y
CONFIG_SOC_NRF52832_QFAA=y
CONFIG_BOARD_EBYTE_E104_BT5032A=y

# Enable MPU
CONFIG_ARM_MPU=y

# enable GPIO
CONFIG_GPIO=y

# enable uart driver
CONFIG_SERIAL=y

# enable console
CONFIG_CONSOLE=y
CONFIG_UART_CONSOLE=y

#CONFIG_USE_SEGGER_RTT=y
#CONFIG_RTT_CONSOLE=y
#CONFIG_SHELL_BACKEND_RTT=y

# Enable P0_21 as RST
CONFIG_GPIO_AS_PINRESET=y
CONFIG_CLOCK_CONTROL_NRF_K32SRC_RC=y
CONFIG_CLOCK_CONTROL_NRF_K32SRC_500PPM=y
```

## boards/arm/holyiot_yj14001/Kconfig.board
```kconfig
# Holyiot YJ-14001 board configuration

# Copyright (c) 2022 Christoppher Biggs <christopher@biggs.id.au>
# SPDX-License-Identifier: Apache-2.0

config BOARD_HOLYIOT_YJ14001
	bool "Holyiot YJ-14001"
	depends on SOC_NRF51822_QFAA
```

## boards/arm/holyiot_yj14001/Kconfig.defconfig
```kconfig
# Holyiot YJ-14001 board configuration

# Copyright (c) 2022 Christoppher Biggs <christopher@biggs.id.au>
# SPDX-License-Identifier: Apache-2.0

if BOARD_HOLYIOT_YJ14001

config BOARD
	default "holyiot_yj14001"

config BT_CTLR
	default BT

endif # BOARD_HOLYIOT_YJ14001
```

## boards/arm/holyiot_yj14001/holyiot_yj14001_defconfig
```kconfig
CONFIG_SOC_SERIES_NRF51X=y
CONFIG_SOC_NRF51822_QFAA=y
CONFIG_BOARD_HOLYIOT_YJ14001=y

# enable GPIO
CONFIG_GPIO=y
```

## boards/riscv/accelerando_corinda/Kconfig.board
```kconfig
# Accelerando Corinda board configuration

config BOARD_ACCELERANDO_CORINDA
	bool "Accelerando Corinda ESP32C3"
	depends on SOC_SERIES_ESP32C3

choice SOC_PART_NUMBER
	default SOC_ESP32C3_MINI_N4
endchoice
```

## boards/riscv/accelerando_corinda/Kconfig.defconfig
```kconfig
# Accelerando Corinda board configuration

config BOARD
	default "accelerando_corinda"
	depends on BOARD_ACCELERANDO_CORINDA

config HEAP_MEM_POOL_ADD_SIZE_BOARD
	int
	default 65535 if WIFI && BT
	default 51200 if WIFI
	default 40960 if BT
	default 4096

choice BT_HCI_BUS_TYPE
	default BT_ESP32 if BT
endchoice
```

## drivers/sensor/vl53l1x/Kconfig
```kconfig
# VL53L0X time of flight sensor configuration options

# Copyright (c) 2017 STMicroelectronics
# SPDX-License-Identifier: Apache-2.0

menuconfig VL53L1X
	bool "VL53L1X long-range time of flight sensor"
	depends on I2C
	select HAS_STLIB
	help
	  Enable driver for VL53L1X I2C-based time of flight sensor.

config VL53L1X_PROXIMITY_THRESHOLD
	int "Proximity threshold in millimeters"
	default 100
	depends on VL53L1X
	help
	  Threshold used for proximity detection when sensor is used with SENSOR_CHAN_PROX.
```

## dts/bindings/gpio/lolin-d1-bus.yaml
```yaml
description: |
    GPIO pins exposed on Wemos Lolin D1 Mini stacking bus.

    The D1 Mini two 1x8-pin headers, one each along
    opposite edges of the board (or in some versions, 2x8 or 2x10).

    Proceeding counter-clockwise from top left:
    * Left-hand-side  8-pin header, RST, 6xGPIO, 3v3
    * Right-hand-side 8-pin header, 5v, Gnd, 4xGPIO, Rx, Tx

    The original (ESP8266) Lolin D1 Mini names these pins as below,
    the numbering is chosen for Zephyr semi-arbitrarily with the
    goal of "least confusion" (i.e. Dn is PINn wherever possible)

      9 - RESET      11 - Tx
     10 - A0         12 - Rx
      0 - D0          1 - D1/SCL
      5 - D5/SCK      2 - D2/SDA
      6 - D6/MISO     3 - D3
      7 - D7/MOSI     4 - D4
      8 - D8/SS         - GND
        - 3v3           - 5v


compatible: "lolin-d1-bus"

include: [gpio-nexus.yaml, base.yaml]
```
