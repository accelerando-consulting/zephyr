## samples/drivers/display/boards/barangaroo.conf
```kconfig
CONFIG_I2C=y
CONFIG_I2C_NRFX=y
CONFIG_SSD1306=y
CONFIG_USE_SEGGER_RTT=y
CONFIG_RTT_CONSOLE=y
CONFIG_SHELL=y
CONFIG_SHELL_BACKEND_SERIAL=n
CONFIG_SHELL_BACKEND_RTT=y
CONFIG_GPIO_SHELL=y
CONFIG_I2C_SHELL=y
CONFIG_KERNEL_SHELL=y
```
