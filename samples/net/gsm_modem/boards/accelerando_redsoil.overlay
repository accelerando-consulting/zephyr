
&uart1 {
       	/*compatible = "nordic,nrf-uarte";*/
	current-speed = <115200>;
	status = "okay";
	rx-pin = <9>;
	tx-pin = <10>;

	gsm: gsm_modem {
		compatible = "gsm,ppp";
		/*status = "okay";*/
	};
};

