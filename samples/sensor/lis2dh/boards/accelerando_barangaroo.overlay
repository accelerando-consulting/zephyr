&i2c0 {
        lis2dh12@18 {
                compatible = "st,lis1dh12", "st,lis2dh";
                reg = <0x18>;
                irq-gpios = <&gpio0 17 GPIO_ACTIVE_HIGH>;
                label = "LIS2DH12-ACCEL";
        };

};