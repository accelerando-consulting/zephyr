/*
 * Copyright (c) 2018-2019 Peter Bigot Consulting, LLC
 *
 * SPDX-License-Identifier: Apache-2.0
 */

&i2c0 { 
	sht3xd@45 {
		compatible = "sensirion,sht3xd";
		reg = <0x45>;
		label = "SHT3XD";
		//alert-gpios = <&gpio0 2 GPIO_ACTIVE_HIGH>;
	};
};
