
/ {
  aliases {
    lora0 = &lora;
  };
};

&spi1 {
  lora: sx1276@0 {
    compatible = "semtech,sx1276";
    reg = <0>;
    label = "sx1276";
    reset-gpios = <&gpio0 24 (GPIO_PULL_UP   | GPIO_ACTIVE_LOW )>;
    dio-gpios   = <&gpio0 13 (GPIO_PULL_DOWN | GPIO_ACTIVE_HIGH)>,
    	          <&gpio1 13 (GPIO_PULL_DOWN | GPIO_ACTIVE_HIGH)>,
	          <&gpio0  2 (GPIO_PULL_DOWN | GPIO_ACTIVE_HIGH)>;
    spi-max-frequency = <1000000>;
    power-amplifier-output = "pa-boost";
   };
};

    /*
	Accelerando Hailstone LoRa shield nRF52 Pin Assignments

	A0(DIO2) = P0.02
	D0(DIO1) = P1.13
	D1(SCL)  = P0.31
	D2(SDA)  = P0.30
	D3(RST)  = P0.24
	D4(DIO0) = P0.13
	D5(SCK)  = P1.11
	D6(MISO) = P1.10
	D7(MOSI) = P0.03
	D8(NSS)  = P0.28
    */
